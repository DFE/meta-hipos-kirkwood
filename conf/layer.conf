## conf/layer.conf
```bitbake
# We have a conf and classes directory, append to BBPATH
BBPATH .= ":${LAYERDIR}"

# We have a recipes directory, add to BBFILES
BBFILES += "${LAYERDIR}/recipes*/*/*.bb ${LAYERDIR}/recipes*/*/*.bbappend"

BBFILE_COLLECTIONS += "meta-hipos-kirkwood"
BBFILE_PATTERN_meta-hipos-kirkwood := "^${LAYERDIR}/"
BBFILE_PRIORITY_meta-hipos-kirkwood = "15"
```

## conf/machine/hidav-kirkwood.conf
```bitbake
require conf/machine/include/kirkwood.inc

IMAGE_FSTYPES = "tar.bz2 squashfs ext4"
MACHINE_FEATURES = "kernel26 apm usbgadget usbhost vfat ext2 ethernet"

UBOOT_MACHINE = "openrd_ultimate"
UBOOT_ARCH = "arm"
```

## conf/machine/hikirk.conf
```bitbake
require conf/machine/include/kirkwood.inc

IMAGE_FSTYPES = "tar.bz2 squashfs ext4"
MACHINE_FEATURES = "kernel26 apm usbgadget usbhost vfat ext2 ethernet"

UBOOT_MACHINE = "hikirk_config"
UBOOT_ARCH = "arm"

# Machine specific preferences

PREFERRED_PROVIDER_virtual/bootloader 	 = "u-boot-kirkwood"
PREFERRED_PROVIDER_virtual/kernel 	 = "linux-yocto"
EXTRA_IMAGEDEPENDS 			+= "virtual/bootloader virtual/kernel"

# Due to dependancies the packages 'mesa' and 'mesa-gl' will be built during
# 'bitbake world'. Both packages provide target 'virtual/libgl'.
# During 'bitbake world' an error occurs with these packages.
# This error prevents the built of targets for MACHINE hikirk. The cause is not
# known, there are no dependencies. As workaround, the built of package
# 'mesa-gl' is prevented by changing the PREFERED_PROVIDER for 'virtual/libgl'.
# Default is 'mesa-gl'.

PREFERRED_PROVIDER_virtual/libgl ?= "mesa"

# set a default machine kernel package revision since the 
# meta-texasinstruments layer tries to expand this value in
# machin specific packages which do not set COMPATIBLE_MACHINE.
# So if we do not set this dummy value here then the TI layer
# will break our kirkwood build even though we do not build for
# a TI machine.

MACHINE_KERNEL_PR = "r0"
```

## conf/machine/include/kirkwood.inc
```bitbake
#@TYPE: Machine
#@DESCRIPTION: Machine configuration for various different Marvell Kirkwood based devices

require conf/machine/include/tune-arm926ejs.inc
TARGET_ARCH = "arm"


SERIAL_CONSOLE = "115200 ttyS0"

# Currently all the orion devices we support use uImage
KERNEL_IMAGETYPE = "uImage"
UBOOT_ENTRYPOINT = "0x00008000"
UBOOT_LOADADDRESS = "0x00008000"
```
